/* SPDX-License-Identifier: Apache-2.0 */


/ {
	chosen {
		zephyr,bt-c2h-uart=&uart1;
	};
};


&uart1 {
	compatible = "nordic,nrf-uarte";
	current-speed = <1000000>;
	status = "okay";
	rx-pin = <33>;
	tx-pin = <34>;
	rts-pin = <35>;
	cts-pin = <36>;
	hw-flow-control;
};
